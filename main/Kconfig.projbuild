## main/Kconfig.projbuild
```kconfig
menu "iFeel GPIO Configuration"

    config IFEEL_DS18B20_GPIO
        int "DS18B20 one-wire GPIO"
        default 7
        range 0 21
        help
            GPIO number for the DS18B20 temperature sensor data line.

    config IFEEL_IR_GPIO
        int "GREE IR transmitter GPIO"
        default 0
        range 0 21
        help
            GPIO number for the IR LED (GREE AC transmitter).

    config IFEEL_BUTTON_0_GPIO
        int "Button 0 GPIO"
        default 3
        range 0 21
        help
            GPIO number for button 0 (short: toggle AC on/off; long: -).

    config IFEEL_BUTTON_1_GPIO
        int "Button 1 GPIO"
        default 4
        range 0 21
        help
            GPIO number for button 1 (short: adjust AC setpoint; long: limit config).

    config IFEEL_BUTTON_2_GPIO
        int "Button 2 GPIO"
        default 10
        range 0 21
        help
            GPIO number for button 2 (short: toggle AC display light).

endmenu
```
